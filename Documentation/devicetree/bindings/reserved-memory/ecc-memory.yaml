## Documentation/devicetree/bindings/reserved-memory/ecc-memory.yaml
```yaml
# SPDX-License-Identifier: GPL-2.0-only OR BSD-2-Clause
%YAML 1.2
---
$id: http://devicetree.org/schemas/reserved-memory/ecc-memory.yaml#
$schema: http://devicetree.org/meta-schemas/core.yaml#

title: ECC-Protected Memory

description: |
  This binding represents a reserved memory region containing memory
  protected by ECC.

maintainers:
  - Maxime Ripard <mripard@kernel.org>

allOf:
  - $ref: reserved-memory.yaml

properties:
  compatible:
    const: ecc-memory

  reg:
    description: page-aligned region of ECC-protected memory

required:
  - compatible
  - reg

unevaluatedProperties: false

examples:
  - |
    reserved-memory {
        #address-cells = <1>;
        #size-cells = <1>;

        region@12340000 {
            compatible = "ecc-memory";
            reg = <0x12340000 0x2000>;
        };
    };
```

## drivers/soc/sunxi/Kconfig
```kconfig
# SPDX-License-Identifier: GPL-2.0-only
#
# Allwinner sunXi SoC drivers
#

config SUN50I_H6_EMCE
	tristate "Allwinner H6 Embedded Crypto Engine"
	depends on BLK_INLINE_ENCRYPTION
	default ARCH_SUNXI
	help
	  Say y to enable the Embedded Crypto Engine that allows the
	  inline encryption for the NAND and eMMC.

config SUNXI_MBUS
	bool
	default ARCH_SUNXI
	help
	  Say y to enable the fixups needed to support the Allwinner
	  MBUS DMA quirks.

config SUNXI_SRAM
	bool
	default ARCH_SUNXI
	select REGMAP_MMIO
	help
	  Say y here to enable the SRAM controller support. This
	  device is responsible on mapping the SRAM in the sunXi SoCs
	  whether to the CPU/DMA, or to the devices.
```
